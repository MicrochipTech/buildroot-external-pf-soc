## Config.in
```kconfig
source "$BR2_EXTERNAL_ICICLE_PATH/package/hart-software-services/Config.in.host"
source "$BR2_EXTERNAL_ICICLE_PATH/package/dt-overlay-pf-soc/Config.in"
source "$BR2_EXTERNAL_ICICLE_PATH/package/mchp_examples/Config.in"
```

## board/microchip/icicle/linux_56_defconfig
```kconfig
CONFIG_SYSVIPC=y
CONFIG_NO_HZ_IDLE=y
CONFIG_HIGH_RES_TIMERS=y
CONFIG_IKCONFIG=y
CONFIG_IKCONFIG_PROC=y
CONFIG_CGROUPS=y
CONFIG_CGROUP_BPF=y
CONFIG_NAMESPACES=y
CONFIG_USER_NS=y
CONFIG_CHECKPOINT_RESTORE=y
CONFIG_BLK_DEV_INITRD=y
CONFIG_KALLSYMS_ALL=y
CONFIG_BPF_SYSCALL=y
CONFIG_USERFAULTFD=y
CONFIG_EMBEDDED=y
CONFIG_SOC_MICROCHIP_POLARFIRE=y
CONFIG_SOC_PFSOC=y
CONFIG_SMP=y
CONFIG_NR_CPUS=5
CONFIG_HZ_100=y
CONFIG_CMDLINE="earlyprintk debug console=ttyS0,115200n8 root=mmcblk0p3 uio_pdrv_genirq.of_id=generic-uio pci-hpmemsize=0M libata.force=noncq"
CONFIG_MODULES=y
CONFIG_MODULE_UNLOAD=y
CONFIG_BLK_DEV_ZONED=y
CONFIG_SPARSEMEM_MANUAL=y
CONFIG_NET=y
CONFIG_PACKET=y
CONFIG_UNIX=y
CONFIG_INET=y
CONFIG_CFG80211=m
CONFIG_MAC80211=m
CONFIG_PCI=y
CONFIG_PCI_DEBUG=y
CONFIG_PCI_HOST_GENERIC=y
CONFIG_PCIE_MICROCHIP_HOST=y
CONFIG_DEVTMPFS=y
CONFIG_DEVTMPFS_MOUNT=y
CONFIG_MTD=y
CONFIG_MTD_BLOCK=y
CONFIG_MTD_CFI=y
CONFIG_MTD_CFI_INTELEXT=y
CONFIG_MTD_CFI_AMDSTD=y
CONFIG_MTD_CFI_STAA=y
CONFIG_MTD_PHYSMAP=y
CONFIG_BLK_DEV_LOOP=y
CONFIG_BLK_DEV_NBD=y
CONFIG_VIRTIO_BLK=y
CONFIG_BLK_DEV_NVME=y
CONFIG_EEPROM_AT24=y
CONFIG_BLK_DEV_SD=y
CONFIG_BLK_DEV_SR=y
CONFIG_ATA=y
CONFIG_SATA_AHCI=y
CONFIG_SATA_AHCI_PLATFORM=y
CONFIG_ATA_GENERIC=y
CONFIG_TARGET_CORE=y
CONFIG_TCM_IBLOCK=y
CONFIG_TCM_FILEIO=y
CONFIG_NETDEVICES=y
CONFIG_MACB=y
CONFIG_VITESSE_PHY=y
# CONFIG_WLAN_VENDOR_ADMTEK is not set
# CONFIG_WLAN_VENDOR_ATH is not set
# CONFIG_WLAN_VENDOR_ATMEL is not set
# CONFIG_WLAN_VENDOR_BROADCOM is not set
# CONFIG_WLAN_VENDOR_CISCO is not set
CONFIG_IWLWIFI=m
CONFIG_IWLMVM=m
# CONFIG_WLAN_VENDOR_INTERSIL is not set
# CONFIG_WLAN_VENDOR_MARVELL is not set
# CONFIG_WLAN_VENDOR_MEDIATEK is not set
# CONFIG_WLAN_VENDOR_RALINK is not set
# CONFIG_WLAN_VENDOR_REALTEK is not set
# CONFIG_WLAN_VENDOR_RSI is not set
# CONFIG_WLAN_VENDOR_ST is not set
# CONFIG_WLAN_VENDOR_TI is not set
# CONFIG_WLAN_VENDOR_ZYDAS is not set
# CONFIG_WLAN_VENDOR_QUANTENNA is not set
CONFIG_INPUT_EVDEV=y
CONFIG_SERIAL_8250=y
CONFIG_SERIAL_8250_CONSOLE=y
CONFIG_SERIAL_OF_PLATFORM=y
CONFIG_SERIAL_EARLYCON_RISCV_SBI=y
CONFIG_HW_RANDOM=y
CONFIG_HW_RANDOM_POLARFIRE_SOC=y
CONFIG_I2C=y
CONFIG_I2C_CHARDEV=y
CONFIG_I2C_MICROSEMI=y
CONFIG_I2C_OCORES=y
CONFIG_GPIOLIB=y
CONFIG_GPIO_SYSFS=y
CONFIG_GPIO_MICROSEMI=y
CONFIG_PMBUS=y
CONFIG_USB=y
CONFIG_USB_XHCI_HCD=y
CONFIG_USB_XHCI_PLATFORM=y
CONFIG_USB_EHCI_HCD=y
CONFIG_USB_EHCI_HCD_PLATFORM=y
CONFIG_USB_OHCI_HCD=y
CONFIG_USB_OHCI_HCD_PLATFORM=y
CONFIG_USB_ACM=y
CONFIG_USB_STORAGE=y
CONFIG_USB_UAS=y
CONFIG_USB_MUSB_HDRC=y
CONFIG_USB_MUSB_MPFS_MICROCHIP=y
CONFIG_USB_INVENTRA_DMA=y
CONFIG_USB_SERIAL=y
CONFIG_NOP_USB_XCEIV=y
CONFIG_MMC=y
CONFIG_MMC_SDHCI=y
CONFIG_MMC_SDHCI_PLTFM=y
CONFIG_MMC_SDHCI_CADENCE=y
CONFIG_RTC_CLASS=y
CONFIG_DMADEVICES=y
CONFIG_SF_PDMA=y
CONFIG_UIO=y
CONFIG_UIO_PDRV_GENIRQ=y
CONFIG_UIO_DMEM_GENIRQ=y
CONFIG_UIO_MICROCHIP_CAN=y
CONFIG_UIO_MICROSEMI_DMA=y
CONFIG_VIRTIO_MMIO=y
CONFIG_MAILBOX=y
CONFIG_POLARFIRE_SOC_MAILBOX=y
CONFIG_POLARFIRE_SOC_SYS_CTRL=y
CONFIG_POLARFIRE_SOC_SERIAL_NUMBER=y
CONFIG_POLARFIRE_SOC_FPGA_DIGEST=y
CONFIG_IIO=y
CONFIG_IIO_SW_DEVICE=y
CONFIG_IIO_SW_TRIGGER=y
CONFIG_PAC193X=y
CONFIG_EXT4_FS=y
CONFIG_EXT4_FS_POSIX_ACL=y
CONFIG_FANOTIFY=y
CONFIG_QUOTA=y
CONFIG_AUTOFS4_FS=y
CONFIG_MSDOS_FS=y
CONFIG_VFAT_FS=y
CONFIG_TMPFS=y
CONFIG_TMPFS_POSIX_ACL=y
CONFIG_NLS_CODEPAGE_437=y
CONFIG_NLS_CODEPAGE_850=y
CONFIG_NLS_ASCII=y
CONFIG_NLS_ISO8859_1=y
CONFIG_NLS_UTF8=y
CONFIG_PRINTK_TIME=y
CONFIG_STRIP_ASM_SYMS=y
CONFIG_SCHEDSTATS=y
```

## board/microchip/icicle/osbi-fit-image.its
```
/dts-v1/;

/ {
        description = "U-Boot fitImage for OpenEmbedded/5.6.x+gitAUTOINC+c4bbda2100/icicle-kit-es";
        #address-cells = <1>;

        images {
                kernel@1 {
                        description = "Linux kernel";
                        data = /incbin/("./vmlinux.bin");
                        type = "kernel";
                        arch = "riscv";
                        os = "linux";
                        compression = "none";
                        load = <0x80200000>;
                        entry = <0x80200000>;
                        hash@1 {
                                algo = "sha256";
                        };
                };
/*                ramdisk@initramfs.cpio.gz {
                        description = "buildroot initramfs";
                        data = /incbin/("../work/initramfs.cpio.gz");
                        type = "ramdisk";
                        arch = "riscv";
                        os = "linux";
                        load = <0x84000000>;
                        hash-1 {
                                algo = "sha256";
                        };
                };*/
                fdt@microchip_icicle-kit-es-a000-microchip.dtb {
                        description = "Flattened Device Tree blob";
                        data = /incbin/("./icicle-kit-es.dtb");
                        type = "flat_dt";
                        arch = "riscv";
                        compression = "none";
                        load = <0x82200000>;
                        hash@1 {
                                algo = "sha256";
                        };
                };
	};

        configurations {
                default = "conf@microchip_icicle-kit-es-a000-microchip.dtb";
                conf@microchip_icicle-kit-es-a000-microchip.dtb {
			description = "1 Linux kernel, FDT blob";
			kernel = "kernel@1";
            /*ramdisk = "ramdisk@initramfs.cpio.gz";*/
			fdt = "fdt@microchip_icicle-kit-es-a000-microchip.dtb";
			
			
                        hash@1 {
                                algo = "sha256";
                        };
                };
	};
};
```

## board/microchip/icicle/uboot_smode_defconfig
```kconfig
CONFIG_RISCV=y
CONFIG_NR_DRAM_BANKS=1
CONFIG_ENV_SIZE=0x4000
CONFIG_DEFAULT_DEVICE_TREE="microchip-mpfs-icicle-kit"
CONFIG_TARGET_MICROCHIP_ICICLE=y
CONFIG_ARCH_RV64I=y
CONFIG_RISCV_SMODE=y
CONFIG_SBI_V01=y
CONFIG_DISTRO_DEFAULTS=y
CONFIG_FIT=y
CONFIG_BOOTCOMMAND="setenv fileaddr 0x90000000; load mmc 0:2 ${fileaddr} uEnv.txt; env import -t ${fileaddr} ${filesize}; echo 'Running boot cmd...'; run boot3"
CONFIG_SYS_PROMPT="RISC-V # "
CONFIG_ENV_IS_IN_FAT=y
CONFIG_ENV_FAT_DEVICE_AND_PART="0:2"
CONFIG_SYS_RELOC_GD_ENV_ADDR=y
CONFIG_DM_MTD=y
CONFIG_OF_LIBFDT_OVERLAY=y
```

## configs/icicle_amp_defconfig
```kconfig
BR2_riscv=y
BR2_riscv_custom=y
BR2_RISCV_ISA_CUSTOM_RVM=y
BR2_RISCV_ISA_CUSTOM_RVF=y
BR2_RISCV_ISA_CUSTOM_RVD=y
BR2_RISCV_ISA_CUSTOM_RVC=y
BR2_SHARED_STATIC_LIBS=y
BR2_TOOLCHAIN_BUILDROOT_GLIBC=y
BR2_PACKAGE_HOST_LINUX_HEADERS_CUSTOM_5_12=y
BR2_PACKAGE_GLIBC_UTILS=y
BR2_BINUTILS_VERSION_2_37_X=y
BR2_GCC_VERSION_11_X=y
BR2_TOOLCHAIN_BUILDROOT_CXX=y
BR2_TOOLCHAIN_BUILDROOT_FORTRAN=y
BR2_ROOTFS_DEVICE_CREATION_DYNAMIC_MDEV=y
BR2_SYSTEM_DHCP="eth0"
BR2_ROOTFS_POST_IMAGE_SCRIPT="support/scripts/genimage.sh"
BR2_ROOTFS_POST_SCRIPT_ARGS="-c $(BR2_EXTERNAL_ICICLE_PATH)/board/microchip/icicle_amp/genimage.cfg"
BR2_LINUX_KERNEL=y
BR2_LINUX_KERNEL_CUSTOM_GIT=y
BR2_LINUX_KERNEL_CUSTOM_REPO_URL="https://github.com/polarfire-soc/linux.git"
BR2_LINUX_KERNEL_CUSTOM_REPO_VERSION="mpfs-linux-5.12.x"
BR2_LINUX_KERNEL_DEFCONFIG="icicle_kit_amp"
BR2_LINUX_KERNEL_DTS_SUPPORT=y
BR2_LINUX_KERNEL_INTREE_DTS_NAME="microchip/microchip-mpfs-icicle-kit-context-a"
BR2_LINUX_KERNEL_DTB_OVERLAY_SUPPORT=y
BR2_PACKAGE_OPENSSL=y
BR2_PACKAGE_LIBGPIOD=y
BR2_PACKAGE_NANO=y
BR2_TARGET_ROOTFS_EXT2=y
BR2_TARGET_ROOTFS_EXT2_4=y
BR2_TARGET_ROOTFS_EXT2_SIZE="128M"
BR2_TARGET_UBOOT=y
BR2_TARGET_UBOOT_BUILD_SYSTEM_KCONFIG=y
BR2_TARGET_UBOOT_CUSTOM_VERSION=y
BR2_TARGET_UBOOT_CUSTOM_VERSION_VALUE="2021.10"
BR2_TARGET_UBOOT_PATCH="$(BR2_EXTERNAL_ICICLE_PATH)/board/microchip/icicle_amp/patches/u-boot"
BR2_TARGET_UBOOT_USE_CUSTOM_CONFIG=y
BR2_TARGET_UBOOT_CUSTOM_CONFIG_FILE="$(BR2_EXTERNAL_ICICLE_PATH)/board/microchip/icicle_amp/uboot_smode_defconfig"
BR2_TARGET_UBOOT_NEEDS_DTC=y
BR2_PACKAGE_HOST_GENEXT2FS=y
BR2_PACKAGE_HOST_GENIMAGE=y
BR2_PACKAGE_HOST_GPTFDISK=y
BR2_PACKAGE_HOST_MTOOLS=y
BR2_PACKAGE_HOST_UBOOT_TOOLS=y
BR2_PACKAGE_HOST_UBOOT_TOOLS_FIT_SUPPORT=y
BR2_PACKAGE_HOST_UBOOT_TOOLS_ENVIMAGE=y
BR2_PACKAGE_HOST_UBOOT_TOOLS_ENVIMAGE_SOURCE="$(BR2_EXTERNAL_ICICLE_PATH)/board/microchip/icicle_amp/uboot-env.txt"
BR2_PACKAGE_HOST_UBOOT_TOOLS_ENVIMAGE_SIZE="0x4000"
BR2_PACKAGE_HOST_HART_SOFTWARE_SERVICES=y
BR2_PACKAGE_HOST_HSS_PAYLOAD_GENERATOR=y
BR2_PACKAGE_HOST_HSS_PAYLOAD_GENERATOR_CFG="$(BR2_EXTERNAL_ICICLE_PATH)/board/microchip/icicle_amp/config.yaml"
BR2_PACKAGE_HOST_HSS_PAYLOAD_GENERATOR_SRC="$(BINARIES_DIR)/u-boot.bin"
BR2_PACKAGE_DT_OVERLAY_PF_SOC=y
BR2_PACKAGE_DT_OVERLAY_PF_SOC_PLATFORM="icicle_kit_es_amp"
BR2_PACKAGE_MCHP_EXAMPLES=y
```

## configs/icicle_defconfig
```kconfig
BR2_riscv=y
BR2_riscv_custom=y
BR2_RISCV_ISA_CUSTOM_RVM=y
BR2_RISCV_ISA_CUSTOM_RVF=y
BR2_RISCV_ISA_CUSTOM_RVD=y
BR2_RISCV_ISA_CUSTOM_RVC=y
BR2_TOOLCHAIN_BUILDROOT_GLIBC=y
BR2_KERNEL_HEADERS_VERSION=y
BR2_DEFAULT_KERNEL_VERSION="5.6.18"
BR2_PACKAGE_HOST_LINUX_HEADERS_CUSTOM_5_6=y
BR2_PACKAGE_GLIBC_UTILS=y
BR2_BINUTILS_VERSION_2_36_X=y
BR2_GCC_VERSION_10_X=y
BR2_TOOLCHAIN_BUILDROOT_CXX=y
BR2_ROOTFS_DEVICE_CREATION_DYNAMIC_MDEV=y
BR2_ROOTFS_POST_IMAGE_SCRIPT="support/scripts/genimage.sh"
BR2_ROOTFS_POST_SCRIPT_ARGS="-c $(BR2_EXTERNAL_ICICLE_PATH)/board/microchip/icicle/genimage.cfg"
BR2_LINUX_KERNEL=y
BR2_LINUX_KERNEL_CUSTOM_VERSION=y
BR2_LINUX_KERNEL_CUSTOM_VERSION_VALUE="5.6.18"
BR2_LINUX_KERNEL_PATCH="$(BR2_EXTERNAL_ICICLE_PATH)/board/microchip/icicle/patches/linux"
BR2_LINUX_KERNEL_USE_CUSTOM_CONFIG=y
BR2_LINUX_KERNEL_CUSTOM_CONFIG_FILE="$(BR2_EXTERNAL_ICICLE_PATH)/board/microchip/icicle/linux_56_defconfig"
BR2_LINUX_KERNEL_DTS_SUPPORT=y
BR2_LINUX_KERNEL_CUSTOM_DTS_PATH="$(BR2_EXTERNAL_ICICLE_PATH)/board/microchip/icicle/icicle_kit_es.dts"
BR2_LINUX_KERNEL_DTB_OVERLAY_SUPPORT=y
BR2_PACKAGE_NANO=y
BR2_TARGET_ROOTFS_EXT2=y
BR2_TARGET_ROOTFS_EXT2_4=y
BR2_TARGET_ROOTFS_EXT2_SIZE="128M"
BR2_TARGET_UBOOT=y
BR2_TARGET_UBOOT_BUILD_SYSTEM_KCONFIG=y
BR2_TARGET_UBOOT_CUSTOM_VERSION=y
BR2_TARGET_UBOOT_CUSTOM_VERSION_VALUE="2020.10"
BR2_TARGET_UBOOT_PATCH="$(BR2_EXTERNAL_ICICLE_PATH)/board/microchip/icicle/patches/u-boot"
BR2_TARGET_UBOOT_USE_CUSTOM_CONFIG=y
BR2_TARGET_UBOOT_CUSTOM_CONFIG_FILE="$(BR2_EXTERNAL_ICICLE_PATH)/board/microchip/icicle/uboot_smode_defconfig"
BR2_TARGET_UBOOT_NEEDS_DTC=y
BR2_PACKAGE_HOST_GENEXT2FS=y
BR2_PACKAGE_HOST_GENIMAGE=y
BR2_PACKAGE_HOST_GPTFDISK=y
BR2_PACKAGE_HOST_MTOOLS=y
BR2_PACKAGE_HOST_UBOOT_TOOLS=y
BR2_PACKAGE_HOST_UBOOT_TOOLS_FIT_SUPPORT=y
BR2_PACKAGE_HOST_UBOOT_TOOLS_ENVIMAGE=y
BR2_PACKAGE_HOST_UBOOT_TOOLS_ENVIMAGE_SOURCE="$(BR2_EXTERNAL_ICICLE_PATH)/board/microchip/icicle/uboot-env.txt"
BR2_PACKAGE_HOST_UBOOT_TOOLS_ENVIMAGE_SIZE="0x4000"
BR2_PACKAGE_HOST_HART_SOFTWARE_SERVICES=y
BR2_PACKAGE_HOST_HSS_PAYLOAD_GENERATOR=y
BR2_PACKAGE_HOST_HSS_PAYLOAD_GENERATOR_CFG="$(BR2_EXTERNAL_ICICLE_PATH)/board/microchip/icicle/config.yaml"
BR2_PACKAGE_HOST_HSS_PAYLOAD_GENERATOR_SRC="$(BINARIES_DIR)/u-boot.bin"
BR2_PACKAGE_DT_OVERLAY_PF_SOC=y
BR2_PACKAGE_DT_OVERLAY_PF_SOC_PLATFORM="icicle_kit_es"
BR2_PACKAGE_MCHP_EXAMPLES=y
```

## package/amp_examples/Config.in
```kconfig
config BR2_PACKAGE_AMP_EXAMPLES
	bool "build AMP example"
	help
	  Build the AMP freeRTOS binary to be
	  included in the HSS payload.bin
```

## package/dt-overlay-pf-soc/Config.in
```kconfig
config BR2_PACKAGE_DT_OVERLAY_PF_SOC
	bool "PolarFire SOC DT overlay and FIT image"
	help
	  Generate a FIT image and overlays for the Microchip
	  PolarFire SOC platform.

if BR2_PACKAGE_DT_OVERLAY_PF_SOC

config BR2_PACKAGE_DT_OVERLAY_PF_SOC_PLATFORM
	string "platform name"
	help
	  Available platforms are: icicle_kit_es

choice
	prompt "output"
	default BR2_PACKAGE_DT_OVERLAY_PF_SOC_FIT
	help
	  Build only the device tree overlays or build them and embed
	  them in a FIT image.

config BR2_PACKAGE_DT_OVERLAY_PF_SOC_FIT
	bool "FIT Image"

config BR2_PACKAGE_DT_OVERLAY_PF_SOC_ONLY
	bool "dtbos only"
endchoice
endif
```

## package/hart-software-services/Config.in.host
```kconfig
config BR2_PACKAGE_HOST_HART_SOFTWARE_SERVICES
	bool "Hart Software Services"
	help
	  Microchip Hart Software Services package for
	  PolarFire SOC.

if BR2_PACKAGE_HOST_HART_SOFTWARE_SERVICES

config BR2_PACKAGE_HOST_HSS_PAYLOAD_GENERATOR
	bool "Payload Generator"
	help
	  Microchip PolarFire SOC Payload Generator

if BR2_PACKAGE_HOST_HSS_PAYLOAD_GENERATOR

config BR2_PACKAGE_HOST_HSS_PAYLOAD_GENERATOR_CFG
	string "Config file path and source location"
	help
	  Path to config.yaml file (including config.yaml)

config BR2_PACKAGE_HOST_HSS_PAYLOAD_GENERATOR_SRC
	string "Payload file path and binary location"
	help
	  Path to payload binary file (including file name)
	  Must match payload file name in config.yaml file
endif
endif
```

## package/mchp_examples/Config.in
```kconfig
config BR2_PACKAGE_MCHP_EXAMPLES
	bool "mchp_examples"
	depends on BR2_PACKAGE_LIBOPENSSL
	depends on BR2_PACKAGE_LIBGPIOD
	help
	  blah blah blah
```

## package/polarfire-soc-fit-image/Config.in
```kconfig
config BR2_PACKAGE_POLARFIRE_SOC_FIT_IMAGE
	bool "PolarFire SOC FIT image"
	help
	  Generate a FIT image and overlays for the Microchip
	  PolarFire SOC platform.

if BR2_PACKAGE_POLARFIRE_SOC_FIT_IMAGE

config BR2_PACKAGE_POLARFIRE_SOC_FIT_IMAGE_PLATFORM
	string "platform name"
	help
	  Available platforms are: icicle-kit-es

choice
	prompt "output"
	default BR2_PACKAGE_POLARFIRE_SOC_FIT
	help
	  Build only the device tree overlays or build them and embed
	  them in a FIT image.

config BR2_PACKAGE_POLARFIRE_SOC_FIT
	bool "FIT Image"

config BR2_PACKAGE_POLARFIRE_SOC_DTBO_ONLY
	bool "DTBOs only"
endchoice
endif
```
